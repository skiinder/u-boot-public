## configs/atguigupi_defconfig
```kconfig
CONFIG_ARM=y
CONFIG_ARCH_SUNXI=y
CONFIG_DEFAULT_DEVICE_TREE="sun8i-v3s-atguigupi"
CONFIG_SPL=y
CONFIG_MACH_SUN8I_V3S=y
CONFIG_DRAM_CLK=360
CONFIG_VIDEO_LCD_DCLK_PHASE=0
CONFIG_SPL_SPI_SUNXI=y
# CONFIG_HAS_ARMV7_SECURE_BASE is not set
CONFIG_USE_BOOTARGS=y
CONFIG_BOOTARGS="console=tty0 console=ttyS0,115200 panic=5 rootwait root=/dev/mtdblock3 rw rootfstype=squashfs init=/sbin/preinit"
CONFIG_BOOTCOMMAND="sf probe 0; sf read 0x41800000 0x80000 0x8000; sf read 0x41000000 0x88000 0x6F8000; bootz 0x41000000 - 0x41800000;"
# CONFIG_NET is not set
CONFIG_MTD=y
CONFIG_DM_MTD=y
CONFIG_DM_REGULATOR=y
CONFIG_DM_PWM=y
CONFIG_PWM_SUNXI=y
CONFIG_BOOTDEV_SPI_FLASH=y
CONFIG_SPI_FLASH_BAR=y
CONFIG_SPI_FLASH_WINBOND=y
CONFIG_SPI=y
```
